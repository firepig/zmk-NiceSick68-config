#include <dt-bindings/zmk/matrix_transform.h>
/ {
    chosen {
        zmk,kscan =&default_kscan;
        zmk,matrix_transform = &default_transform;
    };

    default_kscan: kscan {
        compatible = "zmk,kscan-gpio-matrix";
        label = "default_kscan";
        diode-direction = "col2row";

        row-gpios = <&gpio0 17 (GPIO_ACTIVE_HIGH | GPIO_PULL_DOWN)>,
                    <&gpio0 20 (GPIO_ACTIVE_HIGH | GPIO_PULL_DOWN)>,
                    <&gpio0 22 (GPIO_ACTIVE_HIGH | GPIO_PULL_DOWN)>,
                    <&gpio0 24 (GPIO_ACTIVE_HIGH | GPIO_PULL_DOWN)>,
                    <&gpio1 00 (GPIO_ACTIVE_HIGH | GPIO_PULL_DOWN)>


        col-gpios = <&gpio0 11 (GPIO_ACTIVE_LOW | GPIO_PULL_DOWN)>,
            <&gpio1 04 (GPIO_ACTIVE_LOW | GPIO_PULL_DOWN)>,
            <&gpio1 06 (GPIO_ACTIVE_LOW | GPIO_PULL_DOWN)>,
            <&gpio1 07 (GPIO_ACTIVE_LOW | GPIO_PULL_DOWN)>,
            <&gpio1 02 (GPIO_ACTIVE_LOW | GPIO_PULL_DOWN)>,
            <&gpio1 01 (GPIO_ACTIVE_LOW | GPIO_PULL_DOWN)>,
            <&gpio0 31 (GPIO_ACTIVE_LOW | GPIO_PULL_DOWN)>,
            <&gpio0 29 (GPIO_ACTIVE_LOW | GPIO_PULL_DOWN)>,
            <&gpio0 02 (GPIO_ACTIVE_LOW | GPIO_PULL_DOWN)>,
            <&gpio1 15 (GPIO_ACTIVE_LOW | GPIO_PULL_DOWN)>,
            <&gpio1 13 (GPIO_ACTIVE_LOW | GPIO_PULL_DOWN)>,
            <&gpio1 11 (GPIO_ACTIVE_LOW | GPIO_PULL_DOWN)>,
            <&gpio0 10 (GPIO_ACTIVE_LOW | GPIO_PULL_DOWN)>,
            <&gpio0 09 (GPIO_ACTIVE_LOW | GPIO_PULL_DOWN)>,
            <&gpio0 06 (GPIO_ACTIVE_LOW | GPIO_PULL_DOWN)>;

    }
}